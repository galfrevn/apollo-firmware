## main/Kconfig.projbuild
```kconfig
menu "Xiaozhi Assistant"

config APOLLO_PROTOCOL
    bool "Use the Apollo desk agent protocol"
    default n
    help
        Talk to an Apollo backend (a Cloudflare Worker running the agents SDK)
        instead of a xiaozhi server. The connection url, auth token and device
        id are read from the NVS namespace "apollo" rather than from an OTA
        config response, so no OTA endpoint is required.

        Apollo carries raw PCM in both directions, so this also selects the
        PCM uplink below.

config APOLLO_URL
    string "Apollo base url"
    depends on APOLLO_PROTOCOL
    default ""
    help
        Base websocket url of the Apollo worker, without a path, for example
        wss://apollo.example.workers.dev. Used only when the NVS namespace
        "apollo" has no "url" key, so a provisioned device overrides this.

config APOLLO_TOKEN
    string "Apollo device shared secret"
    depends on APOLLO_PROTOCOL
    default ""
    help
        Value of DEVICE_SHARED_SECRET on the worker. Same NVS override rule as
        APOLLO_URL.

        Do not commit a real secret to sdkconfig.defaults: set it in the local
        (gitignored) sdkconfig instead, or provision NVS.

config APOLLO_DEVICE_ID
    string "Apollo device id"
    depends on APOLLO_PROTOCOL
    default "desk"
    help
        Agent instance name, which is also the conversation the device joins.
        Falls back to the MAC address when left empty.

config APOLLO_NTP_SERVER
    string "NTP server"
    depends on APOLLO_PROTOCOL
    default "pool.ntp.org"
    help
        Skipping the xiaozhi activation also skips the only place the clock was
        ever set, so the device syncs its own time instead.

config APOLLO_TIMEZONE
    string "POSIX timezone"
    depends on APOLLO_PROTOCOL
    default "<-03>3"
    help
        POSIX TZ string used for the on-screen clock. The default is Argentina
        (UTC-3, no DST). Note the sign convention is inverted: UTC-3 is "3".

config APOLLO_RAW_PCM_UPLINK
    bool "Send microphone audio as raw PCM instead of Opus"
    default y if APOLLO_PROTOCOL
    default n
    help
        Skips the Opus encoder and pushes 16 kHz mono PCM frames straight to
        the send queue. Costs far more bandwidth, but means the server needs no
        Opus decoder, which matters when it runs somewhere without one.

config OTA_URL
    string "Default OTA URL"
    default "https://api.tenclass.net/xiaozhi/ota/"
    help
        The application will access this URL to check for new firmwares and server address.

choice
    prompt "Flash Assets"
    default FLASH_DEFAULT_ASSETS if !USE_EMOTE_MESSAGE_STYLE
    default FLASH_EXPRESSION_ASSETS if USE_EMOTE_MESSAGE_STYLE
    help
        Select the assets to flash.

    config FLASH_NONE_ASSETS
        bool "Do not flash assets"
    config FLASH_DEFAULT_ASSETS
        bool "Flash Default Assets"
        depends on !USE_EMOTE_MESSAGE_STYLE
    config FLASH_CUSTOM_ASSETS
        bool "Flash Custom Assets"
    config FLASH_EXPRESSION_ASSETS
        bool "Flash Emote Assets"
        depends on USE_EMOTE_MESSAGE_STYLE
endchoice

config CUSTOM_ASSETS_FILE
    depends on FLASH_CUSTOM_ASSETS
    string "Custom Assets File"
    default "assets.bin"
    help
        The custom assets file to flash.
        It can be a local file relative to the project directory or a remote url.

choice
    prompt "Default Language"
    default LANGUAGE_ES_ES
    help
        Select device display language

    config LANGUAGE_ES_ES
        bool "Spanish"
    config LANGUAGE_EN_US
        bool "English"
endchoice

choice BOARD_TYPE
    prompt "Target Board"
    default BOARD_TYPE_WAVESHARE_ESP32_S3_TOUCH_LCD_1_85C
    help
        Two bodies: the 1.85C desk agent Apollo was written for, and a
        pocket-sized e-paper board that runs on a battery.

    config BOARD_TYPE_WAVESHARE_ESP32_S3_TOUCH_LCD_1_85C
        bool "Waveshare ESP32-S3-Touch-LCD-1.85C"
        depends on IDF_TARGET_ESP32S3

    config BOARD_TYPE_WAVESHARE_ESP32_S3_EPAPER_1_54
        bool "Waveshare ESP32-S3-ePaper-1.54 (V2, 8MB flash)"
        depends on IDF_TARGET_ESP32S3
        help
            200x200 monochrome e-paper, no touch, battery powered, three
            switched power rails. The display is not driven yet: the board
            falls back to NoDisplay while the audio and protocol halves are
            brought up.
endchoice

choice DISPLAY_ESP32S3_TOUCH_LCD_1_85C
    depends on BOARD_TYPE_WAVESHARE_ESP32_S3_TOUCH_LCD_1_85C
    prompt "ESP32S3_TOUCH_LCD_1_85C version"
    default VERSION_2_0
    help
        hardware version
    config VERSION_1_0
        bool "version 1.0"
    config VERSION_2_0
        bool "version 2.0"
endchoice


choice DISPLAY_STYLE
    prompt "Select display style"
    default USE_DEFAULT_MESSAGE_STYLE
    help
        Select display style for Xiaozhi device

    config USE_DEFAULT_MESSAGE_STYLE
        bool "Enable default message style"

    config USE_WECHAT_MESSAGE_STYLE
        bool "Enable WeChat Message Style"

    config USE_EMOTE_MESSAGE_STYLE
        bool "Emote animation style"
        depends on BOARD_TYPE_WAVESHARE_ESP32_S3_TOUCH_LCD_1_85C
endchoice

config USE_MULTILINE_CHAT_MESSAGE
    bool "Use multiline chat message display (default mode only)"
    depends on USE_DEFAULT_MESSAGE_STYLE
    default n
    help
        When enabled, the chat message area in the default display mode shows
        multiple wrapped lines that grow upward from the bottom of the screen,
        with auto-adaptive height.
        When disabled (default), a single-line horizontally scrolling label
        is shown at the bottom of the screen.

choice WAKE_WORD_TYPE
    prompt "Wake Word Implementation Type"
    default USE_AFE_WAKE_WORD if (IDF_TARGET_ESP32S3 || IDF_TARGET_ESP32P4 || IDF_TARGET_ESP32S31) && SPIRAM
    default WAKE_WORD_DISABLED
    help
        Choose the type of wake word implementation to use

    config WAKE_WORD_DISABLED
        bool "Disabled"
        help
            Disable wake word detection

    config USE_ESP_WAKE_WORD
        bool "Wakenet model without AFE"
        depends on IDF_TARGET_ESP32C3 || IDF_TARGET_ESP32C5 || IDF_TARGET_ESP32C6 || (IDF_TARGET_ESP32 && SPIRAM)
        help
            Support ESP32 C3、ESP32 C5 与 ESP32 C6, and (ESP32 with PSRAM)

    config USE_AFE_WAKE_WORD
        bool "Wakenet model with AFE"
        depends on (IDF_TARGET_ESP32S3 || IDF_TARGET_ESP32P4 || IDF_TARGET_ESP32S31) && SPIRAM
        help
            Support AEC if available, requires ESP32-S3, ESP32-P4, or ESP32-S31 and PSRAM

    config USE_CUSTOM_WAKE_WORD
        bool "Multinet model (Custom Wake Word)"
        depends on (IDF_TARGET_ESP32S3 || IDF_TARGET_ESP32P4 || IDF_TARGET_ESP32S31) && SPIRAM
        help
            Requires ESP32-S3, ESP32-P4, or ESP32-S31 and PSRAM

    config USE_MICRO_WAKE_WORD
        bool "microWakeWord streaming TFLite model"
        depends on IDF_TARGET_ESP32S3 && SPIRAM
        help
            Runs an ESPHome-style microWakeWord streaming model on the AFE
            output, so AEC and barge-in keep working. The model is embedded
            in the app image from main/assets/wakewords. Requires ESP32-S3
            with PSRAM.

endchoice

config CUSTOM_WAKE_WORD
    string "Custom Wake Word"
    default "xiao tu dou"
    depends on USE_CUSTOM_WAKE_WORD
    help
        Custom Wake Word, use pinyin for Chinese, separated by spaces

config CUSTOM_WAKE_WORD_DISPLAY
    string "Custom Wake Word Display"
    default "小土豆"
    depends on USE_CUSTOM_WAKE_WORD
    help
        Greeting sent to the server after wake word detection

config CUSTOM_WAKE_WORD_THRESHOLD
    int "Custom Wake Word Threshold (%)"
    default 20
    range 1 99
    depends on USE_CUSTOM_WAKE_WORD
    help
        Custom Wake Word Threshold, range 1-99, the smaller the more sensitive, default 20

config MICRO_WAKE_WORD_PHRASE
    string "microWakeWord Phrase"
    default "Hey, Apólo"
    depends on USE_MICRO_WAKE_WORD
    help
        Wake word text reported to the application when the model triggers

config MICRO_WAKE_WORD_PROBABILITY_CUTOFF
    int "microWakeWord Probability Cutoff (%)"
    default 90
    range 1 99
    depends on USE_MICRO_WAKE_WORD
    help
        Sliding-window mean probability required to trigger. The model
        manifest ships 50, but on-device values around 90 keep false
        accepts rare; lower it if real utterances are missed.

config MICRO_WAKE_WORD_SLIDING_WINDOW_SIZE
    int "microWakeWord Sliding Window Size"
    default 5
    range 1 10
    depends on USE_MICRO_WAKE_WORD
    help
        Number of recent inference probabilities averaged before comparing
        against the cutoff. Bigger is smoother but slower to react.

config SEND_WAKE_WORD_DATA
    bool "Send Wake Word Data"
    default y
    depends on USE_AFE_WAKE_WORD || USE_CUSTOM_WAKE_WORD || USE_MICRO_WAKE_WORD
    help
        Send wake word data to the server as the first message of the conversation and wait for response

config WAKE_WORD_DETECTION_IN_LISTENING
    bool "Enable Wake Word Detection in Listening Mode"
    default n
    depends on USE_AFE_WAKE_WORD || USE_CUSTOM_WAKE_WORD || USE_MICRO_WAKE_WORD
    help
        Enable wake word detection while in listening mode.
        When enabled, the device can detect wake word during listening,
        which allows interrupting the current conversation.
        When disabled (default), wake word detection is turned off during listening.

config USE_AUDIO_PROCESSOR
    bool "Enable AFE Audio Processing"
    default y
    depends on (IDF_TARGET_ESP32S3 || IDF_TARGET_ESP32P4 || IDF_TARGET_ESP32S31) && SPIRAM
    help
        Enable the shared AFE uplink path with AEC and VAD. Noise suppression
        is not enabled because this project does not provide an NSNet model.
        Requires ESP32-S3, ESP32-P4, or ESP32-S31 with PSRAM.

config USE_DEVICE_AEC
    bool "Enable Device-Side AEC"
    default n
        depends on USE_AUDIO_PROCESSOR
    help
        To work properly, device-side AEC requires a clean output reference path from the speaker signal and physical acoustic isolation between the microphone and speaker.

config USE_SERVER_AEC
    bool "Enable Server-Side AEC (Unstable)"
    default n
    depends on USE_AUDIO_PROCESSOR
    help
        To work perperly, server-side AEC requires server support

config USE_AUDIO_DEBUGGER
    bool "Enable Audio Debugger"
    default n
    help
        Enable audio debugger, send audio data through UDP to the host machine

menu "WiFi Configuration Method"
    help
        WiFi Configuration Method Selection
    config USE_HOTSPOT_WIFI_PROVISIONING
        bool "Hotspot"
        default y
        help
            Use WiFi Hotspot to transmit WiFi configuration data
    config USE_ESP_BLUFI_WIFI_PROVISIONING
        bool "ESP-BluFi"
        select BT_ENABLED
        select BT_BLE_42_FEATURES_SUPPORTED
        select BT_BLE_BLUFI_ENABLE
        help
            Use the PSA Crypto based BluFi security protocol adopted by ESP-IDF 6.
            The provisioning client must support ffdhe3072, SHA-256, and AES-CTR.
endmenu

config AUDIO_DEBUG_UDP_SERVER
    string "Audio Debug UDP Server Address"
    default "192.168.2.100:8000"
    depends on USE_AUDIO_DEBUGGER
    help
        UDP server address, format: IP:PORT, used to receive audio debugging data

config RECEIVE_CUSTOM_MESSAGE
    bool "Enable Custom Message Reception"
    default n
    help
        Enable custom message reception, allow the device to receive custom messages from the server (preferably through the MQTT protocol)

menu "Camera Configuration"
    depends on !IDF_TARGET_ESP32

    comment "Warning: Please read the help text before modifying these settings."

    config XIAOZHI_CAMERA_MIRROR_CONFIGURED
        bool "Override camera mirror settings"
        default n
        help
            When enabled, the common camera implementations apply the
            horizontal and vertical mirror settings below after the sensor has
            been initialized. Parameterized builds enable this automatically
            when either mirror setting is configured.

    config XIAOZHI_CAMERA_HMIRROR
        bool "Mirror Camera Horizontally"
        default n
        depends on XIAOZHI_CAMERA_MIRROR_CONFIGURED
        help
            Flip the captured camera image across the vertical axis.

    config XIAOZHI_CAMERA_VFLIP
        bool "Mirror Camera Vertically"
        default n
        depends on XIAOZHI_CAMERA_MIRROR_CONFIGURED
        help
            Flip the captured camera image across the horizontal axis.

    config XIAOZHI_CAMERA_ALLOW_JPEG_INPUT
        bool "Allow JPEG Input"
        default n
        help
            Allow JPEG Input format for the camera.

            This option may need to be enabled when using a USB camera.

            Not currently supported when used simultaneously with XIAOZHI_ENABLE_ROTATE_CAMERA_IMAGE.

    config XIAOZHI_ENABLE_HARDWARE_JPEG_ENCODER
        bool "Enable Hardware JPEG Encoder"
        default y
        depends on SOC_JPEG_ENCODE_SUPPORTED
        help
            Use hardware JPEG encoder on ESP32-P4 to encode image to JPEG.
            See https://docs.espressif.com/projects/esp-idf/en/stable/esp32p4/api-reference/peripherals/jpeg.html for more details.

    config XIAOZHI_ENABLE_HARDWARE_JPEG_DECODER
        bool "Enable Hardware JPEG Decoder"
        default n
        depends on SOC_JPEG_DECODE_SUPPORTED && XIAOZHI_CAMERA_ALLOW_JPEG_INPUT
        help
            Use hardware JPEG decoder on ESP32-P4 to decode JPEG to image.
            See https://docs.espressif.com/projects/esp-idf/en/stable/esp32p4/api-reference/peripherals/jpeg.html for more details.

    config XIAOZHI_ENABLE_CAMERA_DEBUG_MODE
        bool "Enable Camera Debug Mode"
        default n
        help
            Enable camera debug mode, print camera debug information to the console.
            Only works on boards that support camera.

    config XIAOZHI_ENABLE_CAMERA_ENDIANNESS_SWAP
        bool "Enable software camera buffer endianness swapping"
        default n
        depends on !CAMERA_SENSOR_SWAP_PIXEL_BYTE_ORDER
        help
            This option treats the camera buffer as a uint16_t[] array and performs byte-swapping (endianness conversion) on each element.

            Should only be modified by development board integration engineers.

            **Incorrect usage may result in incorrect image colors!**

            ATTENTION: If the option CAMERA_SENSOR_SWAP_PIXEL_BYTE_ORDER is available for your sensor, please use that instead.

    menuconfig XIAOZHI_ENABLE_ROTATE_CAMERA_IMAGE
        bool "Enable Camera Image Rotation"
        default n
        depends on !XIAOZHI_CAMERA_ALLOW_JPEG_INPUT
        help
            Enable camera image rotation, rotate the camera image to the correct orientation.
            - On ESP32-P4, rotation is handled by PPA hardware.
            - On other chips, rotation is done in software with performance cost.
            - For 180° rotation, use HFlip + VFlip instead of this option.

            Not currently supported when used simultaneously with XIAOZHI_CAMERA_ALLOW_JPEG_INPUT.

    if XIAOZHI_ENABLE_ROTATE_CAMERA_IMAGE
        choice XIAOZHI_CAMERA_IMAGE_ROTATION_ANGLE
            prompt "Camera Image Rotation Angle (clockwise)"
            default XIAOZHI_CAMERA_IMAGE_ROTATION_ANGLE_90
            help
                Camera image rotation angle.
            config XIAOZHI_CAMERA_IMAGE_ROTATION_ANGLE_90
                bool "90°"
            config XIAOZHI_CAMERA_IMAGE_ROTATION_ANGLE_270
                bool "270°"
            comment "For 180° rotation, use HFlip + VFlip instead of this option"
        endchoice
    endif
endmenu


endmenu
```
